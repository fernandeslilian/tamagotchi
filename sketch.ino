#include <WiFi.h>
#include <PubSubClient.h>
#include <ArduinoJson.h>
#include <Wire.h>
#include <Adafruit_GFX.h>
#include <Adafruit_SSD1306.h>
#include <DHT.h>

// --- CONFIGURAÇÕES DE REDE E MQTT ---
const char* SSID = "Wokwi-GUEST";
const char* PASSWORD = "";
const char* MQTT_BROKER = "broker.hivemq.com";
const int MQTT_PORT = 1883;

// Tópicos MQTT
const char* TOPICO_SENSORES = "tamagotchi/iot/sensores";
const char* TOPICO_TELA     = "tamagotchi/iot/tela";
const char* TOPICO_STATUS   = "tamagotchi/iot/status";

WiFiClient espClient;
PubSubClient mqttClient(espClient);

// --- CONFIGURAÇÕES DE HARDWARE ---
#define SCREEN_WIDTH 128
#define SCREEN_HEIGHT 64
Adafruit_SSD1306 display(SCREEN_WIDTH, SCREEN_HEIGHT, &Wire, -1);

#define DHTPIN 15
#define DHTTYPE DHT22
#define TRIG_PIN 5
#define ECHO_PIN 18
#define BUZZER_PIN 4

DHT dht(DHTPIN, DHTTYPE);

// Variáveis globais de telemetria e estado
float temperatura = 24.0;
float umidade = 50.0;
long distanciaCm = 80;

String estadoAtual = "NORMAL";
String falaAtual = "Tudo bem?";
bool olhosAbertos = true;

unsigned long ultimoPiscar = 0;
unsigned long ultimoEnvioMQTT = 0;

// --- LEITURA DO SENSOR ULTRASSÔNICO ---
long lerDistanciaCm() {
  digitalWrite(TRIG_PIN, LOW);
  delayMicroseconds(2);
  digitalWrite(TRIG_PIN, HIGH);
  delayMicroseconds(10);
  digitalWrite(TRIG_PIN, LOW);
  long duracao = pulseIn(ECHO_PIN, HIGH, 30000);
  if (duracao == 0) return 400;
  return duracao * 0.034 / 2;
}

// --- FUNÇÕES GRÁFICAS (DISPLAY OLED) ---
void desenharCabecalho() {
  display.setTextSize(1);
  display.setTextColor(SSD1306_WHITE);
  display.setCursor(0, 0);
  display.print((int)temperatura);
  display.print("C ");
  display.print((int)umidade);
  display.print("% ");
  display.print(distanciaCm);
  display.print("cm");

  // Indicador de conexão MQTT no canto direito
  display.setCursor(98, 0);
  if (mqttClient.connected()) {
    display.print("[ON]");
  } else {
    display.print("[--]");
  }
  display.drawLine(0, 10, 128, 10, SSD1306_WHITE);
}

void desenharCaixaFala(String texto) {
  display.drawRoundRect(0, 50, 128, 14, 3, SSD1306_WHITE);
  display.setCursor(4, 53);
  display.setTextSize(1);
  display.print(texto);
}

// Sprites do gato 64x38
const uint8_t PROGMEM gatoNormal[] = {
  0x00, 0x00, 0x00, 0x00, 0x00, 0x00, 0x00, 0x00, 0x00, 0x80, 0x00, 0x00, 0x00, 0x00, 0x00, 0x80,
  0x00, 0xE0, 0x00, 0x00, 0x00, 0x00, 0x03, 0x80, 0x00, 0xB0, 0x00, 0x00, 0x00, 0x00, 0x06, 0x80,
  0x00, 0x9C, 0x00, 0x00, 0x00, 0x00, 0x1C, 0x80, 0x00, 0x8A, 0x00, 0x00, 0x00, 0x00, 0x28, 0x80,
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  0x00, 0x00, 0x7F, 0xFF, 0xFF, 0xFF, 0x00, 0x00, 0x00, 0x00, 0x1F, 0xFF, 0xFF, 0xFC, 0x00, 0x00
};

const uint8_t PROGMEM gatoPiscando[] = {
  0x00, 0x00, 0x00, 0x00, 0x00, 0x00, 0x00, 0x00, 0x00, 0x80, 0x00, 0x00, 0x00, 0x00, 0x00, 0x80,
  0x00, 0xE0, 0x00, 0x00, 0x00, 0x00, 0x03, 0x80, 0x00, 0xB0, 0x00, 0x00, 0x00, 0x00, 0x06, 0x80,
  0x00, 0x9C, 0x00, 0x00, 0x00, 0x00, 0x1C, 0x80, 0x00, 0x8A, 0x00, 0x00, 0x00, 0x00, 0x28, 0x80,
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  0x00, 0x00, 0x7F, 0xFF, 0xFF, 0xFF, 0x00, 0x00, 0x00, 0x00, 0x1F, 0xFF, 0xFF, 0xFC, 0x00, 0x00
};

const uint8_t PROGMEM gatoCalor[] = {
  0x00, 0x00, 0x00, 0x00, 0x00, 0x00, 0x00, 0x00, 0x00, 0x80, 0x00, 0x00, 0x00, 0x00, 0x00, 0x80,
  0x00, 0xE0, 0x00, 0x00, 0x00, 0x00, 0x03, 0x80, 0x00, 0xB0, 0x00, 0x00, 0x00, 0x00, 0x06, 0x80,
  0x00, 0x9C, 0x00, 0x00, 0x00, 0x00, 0x1C, 0x80, 0x00, 0x8A, 0x00, 0x00, 0x00, 0x00, 0x28, 0x80,
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  0x00, 0x00, 0x7F, 0xFF, 0xFF, 0xFF, 0x00, 0x00, 0x00, 0x00, 0x1F, 0xFF, 0xFF, 0xFC, 0x00, 0x00
};

const uint8_t PROGMEM gatoFrio[] = {
  0x00, 0x00, 0x00, 0x00, 0x00, 0x00, 0x00, 0x00, 0x00, 0x80, 0x00, 0x00, 0x00, 0x00, 0x00, 0x80,
  0x00, 0xE0, 0x00, 0x00, 0x00, 0x00, 0x03, 0x80, 0x00, 0xB0, 0x00, 0x00, 0x00, 0x00, 0x06, 0x80,
  0x00, 0x9C, 0x00, 0x00, 0x00, 0x00, 0x1C, 0x80, 0x00, 0x8A, 0x00, 0x00, 0x00, 0x00, 0x28, 0x80,
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  0x00, 0x00, 0x7F, 0xFF, 0xFF, 0xFF, 0x00, 0x00, 0x00, 0x00, 0x1F, 0xFF, 0xFF, 0xFC, 0x00, 0x00
};

const uint8_t PROGMEM gatoEstudando[] = {
  0x00, 0x00, 0x00, 0x00, 0x00, 0x00, 0x00, 0x00, 0x00, 0x80, 0x00, 0x00, 0x00, 0x00, 0x00, 0x80,
  0x00, 0xE0, 0x00, 0x00, 0x00, 0x00, 0x03, 0x80, 0x00, 0xB0, 0x00, 0x00, 0x00, 0x00, 0x06, 0x80,
  0x00, 0x9C, 0x00, 0x00, 0x00, 0x00, 0x1C, 0x80, 0x00, 0x8A, 0x00, 0x00, 0x00, 0x00, 0x28, 0x80,
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  0x00, 0x00, 0x7F, 0xFF, 0xFF, 0xFF, 0x00, 0x00, 0x00, 0x00, 0x1F, 0xFF, 0xFF, 0xFC, 0x00, 0x00
};

const uint8_t PROGMEM gatoDormindo[] = {
  0x00, 0x00, 0x00, 0x00, 0x00, 0x00, 0x00, 0x00, 0x00, 0x80, 0x00, 0x00, 0x00, 0x00, 0x00, 0x80,
  0x00, 0xE0, 0x00, 0x00, 0x00, 0x00, 0x03, 0x80, 0x00, 0xB0, 0x00, 0x00, 0x00, 0x00, 0x06, 0x80,
  0x00, 0x9C, 0x00, 0x00, 0x00, 0x00, 0x1C, 0x80, 0x00, 0x8A, 0x00, 0x00, 0x00, 0x00, 0x28, 0xFE,
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  0x00, 0x00, 0x7F, 0xFF, 0xFF, 0xFF, 0x00, 0x00, 0x00, 0x00, 0x1F, 0xFF, 0xFF, 0xFC, 0x00, 0x00
};

const uint8_t PROGMEM gatoFeliz[] = {
  0x00, 0x00, 0x00, 0x00, 0x00, 0x00, 0x00, 0x00, 0x00, 0x80, 0x00, 0x00, 0x00, 0x00, 0x00, 0x80,
  0x00, 0xE0, 0x00, 0x00, 0x00, 0x00, 0x03, 0x80, 0x00, 0xB0, 0x00, 0x00, 0x00, 0x00, 0x06, 0x80,
  0x00, 0x9C, 0x00, 0x00, 0x00, 0x00, 0x1C, 0x80, 0x00, 0x8A, 0x00, 0x00, 0x00, 0x00, 0x28, 0x80,
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  0x00, 0x00, 0x7F, 0xFF, 0xFF, 0xFF, 0x00, 0x00, 0x00, 0x00, 0x1F, 0xFF, 0xFF, 0xFC, 0x00, 0x00
};

const uint8_t PROGMEM gatoTriste[] = {
  0x00, 0x00, 0x00, 0x00, 0x00, 0x00, 0x00, 0x00, 0x00, 0x80, 0x00, 0x00, 0x00, 0x00, 0x00, 0x80,
  0x00, 0xE0, 0x00, 0x00, 0x00, 0x00, 0x03, 0x80, 0x00, 0xB0, 0x00, 0x00, 0x00, 0x00, 0x06, 0x80,
  0x00, 0x9C, 0x00, 0x00, 0x00, 0x00, 0x1C, 0x80, 0x00, 0x8A, 0x00, 0x00, 0x00, 0x00, 0x28, 0x80,
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  0x00, 0x00, 0x7F, 0xFF, 0xFF, 0xFF, 0x00, 0x00, 0x00, 0x00, 0x1F, 0xFF, 0xFF, 0xFC, 0x00, 0x00
};

const uint8_t PROGMEM gatoAssustado[] = {
  0x00, 0x00, 0x00, 0x00, 0x00, 0x00, 0x00, 0x00, 0x00, 0x80, 0x00, 0x00, 0x00, 0x00, 0x00, 0x80,
  0x00, 0xE0, 0x00, 0x00, 0x00, 0x00, 0x03, 0x80, 0x00, 0xB0, 0x00, 0x00, 0x00, 0x00, 0x06, 0x80,
  0x00, 0x9C, 0x00, 0x00, 0x00, 0x00, 0x1C, 0x80, 0x00, 0x8A, 0x00, 0x00, 0x00, 0x00, 0x28, 0x80,
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  0x00, 0x00, 0x7F, 0xFF, 0xFF, 0xFF, 0x00, 0x00, 0x00, 0x00, 0x1F, 0xFF, 0xFF, 0xFC, 0x00, 0x00
};

const uint8_t PROGMEM gatoBravo[] = {
  0x00, 0x00, 0x00, 0x00, 0x00, 0x00, 0x00, 0x00, 0x00, 0x80, 0x00, 0x00, 0x00, 0x00, 0x00, 0x80,
  0x00, 0xE0, 0x00, 0x00, 0x00, 0x00, 0x03, 0x80, 0x00, 0xB0, 0x00, 0x00, 0x00, 0x00, 0x06, 0x80,
  0x00, 0x9C, 0x00, 0x00, 0x00, 0x00, 0x1C, 0x80, 0x00, 0x8A, 0x00, 0x00, 0x00, 0x00, 0x28, 0x80,
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  0x00, 0x00, 0x7F, 0xFF, 0xFF, 0xFF, 0x00, 0x00, 0x00, 0x00, 0x1F, 0xFF, 0xFF, 0xFC, 0x00, 0x00
};

const uint8_t PROGMEM gatoCarinhoso[] = {
  0x00, 0x00, 0x00, 0x00, 0x00, 0x00, 0x00, 0x00, 0x00, 0x80, 0x00, 0x00, 0x00, 0x00, 0x00, 0x80,
  0x00, 0xE0, 0x00, 0x00, 0x00, 0x00, 0x03, 0x80, 0x00, 0xB0, 0x00, 0x00, 0x00, 0x00, 0x06, 0x80,
  0x00, 0x9C, 0x00, 0x00, 0x00, 0x00, 0x1C, 0x80, 0x00, 0x8A, 0x00, 0x00, 0x00, 0x00, 0x28, 0x80,
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  0x00, 0x00, 0x7F, 0xFF, 0xFF, 0xFF, 0x00, 0x00, 0x00, 0x00, 0x1F, 0xFF, 0xFF, 0xFC, 0x00, 0x00
};

void atualizarDisplay() {
  display.clearDisplay();
  desenharCabecalho();
  const uint8_t *sprite = gatoNormal;
  if (estadoAtual == "CALOR") sprite = gatoCalor;
  else if (estadoAtual == "FRIO") sprite = gatoFrio;
  else if (estadoAtual == "ESTUDANDO") sprite = gatoEstudando;
  else if (estadoAtual == "DORMINDO") sprite = gatoDormindo;
  else if (estadoAtual == "FELIZ") sprite = gatoFeliz;
  else if (estadoAtual == "TRISTE") sprite = gatoTriste;
  else if (estadoAtual == "ASSUSTADO") sprite = gatoAssustado;
  else if (estadoAtual == "BRAVO") sprite = gatoBravo;
  else if (estadoAtual == "CARINHOSO") sprite = gatoCarinhoso;
  else if (!olhosAbertos) sprite = gatoPiscando;
  display.drawBitmap(32, 11, sprite, 64, 38, SSD1306_WHITE);
  desenharCaixaFala(falaAtual);
  display.display();
}

// --- CALLBACK MQTT (RECEBIMENTO DE PACOTES DA REDE) ---
void callbackMQTT(char* topic, byte* payload, unsigned int length) {
  Serial.print("\n[REDE - DOWNLINK] Pacote recebido no topico: ");
  Serial.println(topic);

  // Desempacota o JSON recebido no topico da tela.
  JsonDocument doc;
  DeserializationError erro = deserializeJson(doc, payload, length);

  if (erro) {
    Serial.print("Erro ao ler JSON: ");
    Serial.println(erro.c_str());
    return;
  }

  if (doc["estado"].is<const char*>()) {
    estadoAtual = doc["estado"].as<String>();
  }
  if (doc["fala"].is<const char*>()) {
    falaAtual = doc["fala"].as<String>();
  }

  Serial.print("Novo Estado: ");
  Serial.print(estadoAtual);
  Serial.print(" | Nova Fala: ");
  Serial.println(falaAtual);

  // Feedback sonoro de pacote recebido
  tone(BUZZER_PIN, 1400, 100);
  atualizarDisplay();
}

// --- CONEXÃO WI-FI E MQTT COM LWT ---
void conectarWiFi() {
  display.clearDisplay();
  display.setTextSize(1);
  display.setTextColor(SSD1306_WHITE);
  display.setCursor(10, 25);
  display.println("Conectando Wi-Fi...");
  display.display();

  Serial.print("[REDE] Conectando ao Wi-Fi: ");
  Serial.println(SSID);
  WiFi.mode(WIFI_STA);
  WiFi.begin(SSID, PASSWORD);

  while (WiFi.status() != WL_CONNECTED) {
    delay(500);
    Serial.print(".");
  }

  Serial.println("\n[REDE] Wi-Fi conectado!");
  Serial.print("[REDE] Endereco IP (DHCP): ");
  Serial.println(WiFi.localIP());
}

void reconectarMQTT() {
  while (!mqttClient.connected()) {
    Serial.print("[MQTT] Tentando conexao com o Broker (");
    Serial.print(MQTT_BROKER);
    Serial.print(")...");

    // Cria ID único de cliente na rede
    String clientId = "ESP32-Tamagotchi-" + String(random(1000, 9999));

    // Configuração do Last Will and Testament (LWT)
    const char* lwtPayload = "{\"status\":\"offline\"}";

    if (mqttClient.connect(clientId.c_str(), NULL, NULL, TOPICO_STATUS, 1, true, lwtPayload)) {
      Serial.println(" Conectado!");

      // Publica status online (Retained = true)
      mqttClient.publish(TOPICO_STATUS, "{\"status\":\"online\"}", true);

      // Inscreve-se no topico de atualizacao da tela
      mqttClient.subscribe(TOPICO_TELA, 1);
      Serial.print("[MQTT] Inscrito no topico: ");
      Serial.println(TOPICO_TELA);

      tone(BUZZER_PIN, 900, 120);
    } else {
      Serial.print(" Falha, rc=");
      Serial.print(mqttClient.state());
      Serial.println(" Tentando novamente em 3 segundos...");
      delay(3000);
    }
  }
}

void publicarTelemetria() {
  float t = dht.readTemperature();
  float h = dht.readHumidity();
  if (!isnan(t) && !isnan(h)) {
    temperatura = t;
    umidade = h;
  }
  distanciaCm = lerDistanciaCm();

  // Monta o objeto JSON de telemetria
  JsonDocument doc;
  doc["temp"] = serialized(String(temperatura, 1));
  doc["umid"] = serialized(String(umidade, 0));
  doc["dist"] = distanciaCm;

  char buffer[128];
  size_t tamanho = serializeJson(doc, buffer);

  // Publica no Broker MQTT
  if (mqttClient.publish(TOPICO_SENSORES, buffer)) {
    Serial.print("[REDE - UPLINK] Publicado em ");
    Serial.print(TOPICO_SENSORES);
    Serial.print(" (");
    Serial.print(tamanho);
    Serial.print(" bytes): ");
    Serial.println(buffer);
  }
}

void setup() {
  Serial.begin(115200);
  pinMode(TRIG_PIN, OUTPUT);
  pinMode(ECHO_PIN, INPUT);
  pinMode(BUZZER_PIN, OUTPUT);

  dht.begin();

  if (!display.begin(SSD1306_SWITCHCAPVCC, 0x3C)) {
    Serial.println("Erro ao inicializar o display OLED!");
    while (true);
  }

  conectarWiFi();
  mqttClient.setServer(MQTT_BROKER, MQTT_PORT);
  mqttClient.setCallback(callbackMQTT);
}

void loop() {
  if (!mqttClient.connected()) {
    reconectarMQTT();
  }
  mqttClient.loop(); // Mantem o Keep-Alive e escuta pacotes

  unsigned long agora = millis();

  // 1. Publica telemetria na rede a cada 3 segundos (3000 ms)
  if (agora - ultimoEnvioMQTT >= 3000) {
    ultimoEnvioMQTT = agora;
    publicarTelemetria();
  }

  // 2. Animacao local de piscar os olhos a cada 2.5 segundos
  if (agora - ultimoPiscar >= 2500) {
    ultimoPiscar = agora;
    olhosAbertos = false;
    atualizarDisplay();
    delay(150);
    olhosAbertos = true;
  }

  atualizarDisplay();
}
